## Documentation/devicetree/bindings/display/bridge/dumb-vga.txt
```
Passive RGB to VGA bridge
-------------------------

This binding is aimed for entirely passive RGB to VGA bridges that do not
require any configuration.

Required properties:

- compatible: Should be "dumb-vga-bridge"

Optional properties:

- ddc-i2c-bus: phandle to the i2c bus used to communicate with the monitor

Required nodes:

This device has one video port. Its connection is modelled using the OF
graph bindings specified in Documentation/devicetree/bindings/graph.txt. This
connection is meant to be the RGB input bus.


Example
-------

bridge {
        compatible = "dumb-vga-bridge";
        #address-cells = <1>;
        #size-cells = <0>;

        port@0 {
                reg = <0>;
                #address-cells = <1>;
                #size-cells = <0>;

                vga_input: endpoint@0 {
                        reg = <0>;
                        remote-endpoint = <&tcon0_out_vga>;
               };
        };
};
```

## drivers/misc/cape-manager/Kconfig
```kconfig
menuconfig CAPE_MANAGER
	bool "Cape manager support"
	default n
	depends on OF && OF_OVERLAY
	help
	  Cape Managers.

if CAPE_MANAGER

config CAPE_DS2431
	bool "ID on the DS2431 EEPROM"
	depends on W1
	help
	  Pouet.

endif
```

## drivers/staging/rtl8723bs/Kconfig
```kconfig
config RTL8723BS
	tristate "Realtek 8723B SDIO or SPI WiFi"
	depends on WLAN && MMC && CFG80211
	depends on m
	select WIRELESS_EXT
	select WEXT_PRIV
	---help---
	  Help message of RTL8723BS
```

## drivers/staging/rtl8723ds/Kconfig
```kconfig
config RTL8723DS
	tristate "Realtek 8723D SDIO or SPI WiFi"
	depends on WLAN && MMC && CFG80211
	depends on m
	select WIRELESS_EXT
	select WEXT_PRIV
	---help---
	  Help message of RTL8723DS
```
